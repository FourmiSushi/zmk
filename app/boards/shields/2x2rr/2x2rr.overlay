/*
 * Copyright (c) 2022 The ZMK Contributors
 *
 * SPDX-License-Identifier: MIT
 */
#include <dt-bindings/zmk/matrix_transform.h>

/ {
	chosen {
		zmk,kscan = &kscan0;
        zmk,matrix_transform = &default_transform;
	};

	kscan0: kscan_0 {
		compatible = "zmk,kscan-gpio-matrix";

		label = "KSCAN";
		diode-direction = "col2row";

		col-gpios = <&xiao_d 0 GPIO_ACTIVE_HIGH>;

		row-gpios = <&xiao_d 1 (GPIO_ACTIVE_HIGH | GPIO_PULL_DOWN)>,  <&xiao_d 2 (GPIO_ACTIVE_HIGH | GPIO_PULL_DOWN)>;

	};

	default_transform: keymap_transform_0 {
		compatible = "zmk,matrix-transform";
		columns = <1>;
		rows = <2>;
		map = <RC(0,0) RC(0,1)>;
	};

};