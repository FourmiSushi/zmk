## app/boards/shields/2x2rr/Kconfig.defconfig
```kconfig
# Copyright (c) 2022 The ZMK Contributors
# SPDX-License-Identifier: MIT

if SHIELD_2X2RR

config ZMK_KEYBOARD_NAME
    default "2X2RR"

endif
```

## app/boards/shields/2x2rr/Kconfig.shield
```kconfig
# Copyright (c) 2022 The ZMK Contributors
# SPDX-License-Identifier: MIT

config SHIELD_2X2RR
	def_bool $(shields_list_contains,2x2rr)
```

## app/boards/shields/xiao1matrix/Kconfig.defconfig
```kconfig
# Copyright (c) 2022 The ZMK Contributors
# SPDX-License-Identifier: MIT

if SHIELD_XIAO1MATRIX

config ZMK_KEYBOARD_NAME
    default "Xiao 1Matrix"

endif
```

## app/boards/shields/xiao1matrix/Kconfig.shield
```kconfig
# Copyright (c) 2022 The ZMK Contributors
# SPDX-License-Identifier: MIT

config SHIELD_XIAO1MATRIX
	def_bool $(shields_list_contains,xiao1matrix)
```

## app/boards/shields/xiao2board/Kconfig.defconfig
```kconfig
if SHIELD_XIAO2BOARD_LEFT

config ZMK_KEYBOARD_NAME
    default "Xiao 2Board"

config ZMK_SPLIT_ROLE_CENTRAL
    default y

endif

if SHIELD_XIAO2BOARD_LEFT || SHIELD_XIAO2BOARD_RIGHT

config ZMK_SPLIT
    default y

endif
```

## app/boards/shields/xiao2board/Kconfig.shield
```kconfig
config SHIELD_XIAO2BOARD_LEFT
	def_bool $(shields_list_contains,xiao2board_left)

config SHIELD_XIAO2BOARD_RIGHT
	def_bool $(shields_list_contains,xiao2board_right)
```

## app/boards/shields/xiao2key/Kconfig.defconfig
```kconfig
# Copyright (c) 2022 The ZMK Contributors
# SPDX-License-Identifier: MIT

if SHIELD_XIAO2KEY

config ZMK_KEYBOARD_NAME
    default "Xiao 2Key"

endif
```
